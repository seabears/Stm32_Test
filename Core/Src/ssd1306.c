#include "ssd1306.h"

#include "i2c_reg.h"
#include "main.h"

#include <stddef.h>

#define OLED_PAGE_COUNT       (OLED_HEIGHT / 8U)
#define OLED_CONTROL_COMMAND  0x00U
#define OLED_CONTROL_DATA     0x40U

static uint8_t framebuffer[OLED_WIDTH * OLED_PAGE_COUNT];
static uint8_t cursor_x;
static uint8_t cursor_y;

/* 5x7 font, ASCII 0x20 through 0x7E. */
static const uint8_t font5x7[95][5] =
{
  {0x00,0x00,0x00,0x00,0x00},{0x00,0x00,0x5F,0x00,0x00},
  {0x00,0x07,0x00,0x07,0x00},{0x14,0x7F,0x14,0x7F,0x14},
  {0x24,0x2A,0x7F,0x2A,0x12},{0x23,0x13,0x08,0x64,0x62},
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  {0x08,0x04,0x08,0x10,0x08}
};

static bool OLED_WriteCommands(const uint8_t *commands, size_t count)
{
  uint8_t packet[32];
  size_t index;

  if ((commands == NULL) || (count == 0U) || (count > (sizeof(packet) - 1U)))
  {
    return false;
  }

  packet[0] = OLED_CONTROL_COMMAND;
  for (index = 0U; index < count; ++index)
  {
    packet[index + 1U] = commands[index];
  }

  return I2C1_MasterTransmit(OLED_I2C_ADDRESS, packet, count + 1U) == I2C_REG_OK;
}

bool OLED_Init(void)
{
  static const uint8_t init_commands[] =
  {
    0xAE, 0xD5, 0x80, 0xA8, 0x3F, 0xD3, 0x00, 0x40,
    0x8D, 0x14, 0x20, 0x02, 0xA1, 0xC8, 0xDA, 0x12,
    0x81, 0x7F, 0xD9, 0xF1, 0xDB, 0x40, 0xA4, 0xA6,
    0x2E, 0xAF
  };

  HAL_Delay(100U);
  if (!OLED_WriteCommands(init_commands, sizeof(init_commands)))
  {
    return false;
  }

  OLED_Clear();
  OLED_SetCursor(0U, 0U);
  return OLED_Update();
}

bool OLED_Update(void)
{
  uint8_t page;

  for (page = 0U; page < OLED_PAGE_COUNT; ++page)
  {
    uint8_t commands[3] = {(uint8_t)(0xB0U | page), 0x00U, 0x10U};
    uint8_t packet[OLED_WIDTH + 1U];
    uint16_t column;

    if (!OLED_WriteCommands(commands, sizeof(commands)))
    {
      return false;
    }

    packet[0] = OLED_CONTROL_DATA;
    for (column = 0U; column < OLED_WIDTH; ++column)
    {
      packet[column + 1U] =
          framebuffer[((uint16_t)page * OLED_WIDTH) + column];
    }

    if (I2C1_MasterTransmit(OLED_I2C_ADDRESS,
                            packet,
                            sizeof(packet)) != I2C_REG_OK)
    {
      return false;
    }
  }

  return true;
}

void OLED_Clear(void)
{
  size_t index;

  for (index = 0U; index < sizeof(framebuffer); ++index)
  {
    framebuffer[index] = 0U;
  }
}

void OLED_DrawPixel(uint8_t x, uint8_t y, bool on)
{
  uint16_t index;
  uint8_t mask;

  if ((x >= OLED_WIDTH) || (y >= OLED_HEIGHT))
  {
    return;
  }

  index = (uint16_t)x + ((uint16_t)(y / 8U) * OLED_WIDTH);
  mask = (uint8_t)(1U << (y & 7U));

  if (on)
  {
    framebuffer[index] |= mask;
  }
  else
  {
    framebuffer[index] &= (uint8_t)~mask;
  }
}

void OLED_SetCursor(uint8_t x, uint8_t y)
{
  cursor_x = x;
  cursor_y = y;
}

void OLED_WriteChar(char character)
{
  uint8_t column;
  uint8_t row;
  uint8_t glyph_index;

  if (character == '\n')
  {
    cursor_x = 0U;
    cursor_y = (uint8_t)(cursor_y + 8U);
    return;
  }
  if ((character < ' ') || (character > '~'))
  {
    character = '?';
  }
  if ((cursor_x + 6U) > OLED_WIDTH)
  {
    cursor_x = 0U;
    cursor_y = (uint8_t)(cursor_y + 8U);
  }
  if ((cursor_y + 8U) > OLED_HEIGHT)
  {
    return;
  }

  glyph_index = (uint8_t)character - (uint8_t)' ';

  for (column = 0U; column < 5U; ++column)
  {
    uint8_t bits = font5x7[glyph_index][column];

    for (row = 0U; row < 7U; ++row)
    {
      OLED_DrawPixel((uint8_t)(cursor_x + column),
                     (uint8_t)(cursor_y + row),
                     (bits & (1U << row)) != 0U);
    }
  }

  for (row = 0U; row < 8U; ++row)
  {
    OLED_DrawPixel((uint8_t)(cursor_x + 5U),
                   (uint8_t)(cursor_y + row),
                   false);
  }

  cursor_x = (uint8_t)(cursor_x + 6U);
}

void OLED_WriteString(const char *text)
{
  if (text == NULL)
  {
    return;
  }

  while (*text != '\0')
  {
    OLED_WriteChar(*text);
    ++text;
  }
}
